## Kconfig
```kconfig
if SHIELD_SPECTRUM_DONGLE

menuconfig SPECTRUM_DONGLE_UART
    bool "Spectrum Dongle status UART"
    default y
    depends on ZMK_SPLIT_ROLE_CENTRAL
    select SERIAL
    help
      Send the active layer name and up to five split peripheral battery
      levels to an external display controller over a TX-only UART.

if SPECTRUM_DONGLE_UART

config SPECTRUM_DONGLE_UART_SELF_TEST
    bool "Transmit a fixed UART self-test snapshot"
    default n
    help
      Bypass ZMK status collection. Send a fixed, protocol-valid SD1 snapshot
      once per heartbeat with uart_poll_out.
      Use this only to verify the TX pin, wiring, receiver, and display path.

config SPECTRUM_DONGLE_UART_HEARTBEAT_MS
    int "Full status heartbeat interval (ms)"
    default 1000
    range 250 60000
    help
      A complete snapshot is sent at this interval in addition to immediate
      event-driven updates. This lets a receiver recover after a reset.

config SPECTRUM_DONGLE_UART_START_DELAY_MS
    int "Initial status delay (ms)"
    default 500
    range 0 10000

config SPECTRUM_DONGLE_UART_LAYER_NAME_MAX_LEN
    int "Maximum layer-name bytes sent"
    default 32
    range 8 64

module = SPECTRUM_DONGLE_UART
module-str = Spectrum Dongle UART
source "subsys/logging/Kconfig.template.log_config"

endif # SPECTRUM_DONGLE_UART

endif # SHIELD_SPECTRUM_DONGLE
```

## boards/shields/SpectrumDongle/Kconfig.shield
```kconfig
config SHIELD_SPECTRUM_DONGLE
    def_bool $(shields_list_contains,SpectrumDongle)
```

## boards/shields/spectrum_dongle_uart/Kconfig.defconfig
```kconfig
if SHIELD_SPECTRUM_DONGLE_UART

config ZMK_SPLIT
    default y

config ZMK_SPLIT_ROLE_CENTRAL
    default y

config ZMK_SPLIT_BLE_CENTRAL_PERIPHERALS
    default 5

config ZMK_SPLIT_BLE_CENTRAL_BATTERY_LEVEL_FETCHING
    default y

config SPECTRUM_DONGLE_UART
    default y

endif # SHIELD_SPECTRUM_DONGLE_UART
```

## boards/shields/spectrum_dongle_uart/Kconfig.shield
```kconfig
config SHIELD_SPECTRUM_DONGLE_UART
    def_bool $(shields_list_contains,spectrum_dongle_uart)
```
